/**
 * Generated by C-Next Transpiler from: J1939McuHealth.cnx
 * A safer C for embedded systems
 */

#include "J1939McuHealth.h"

#include <stdint.h>
#include <stdbool.h>

// MCU Health frame codec — Proprietary B PGN 0xFFDC (65500), broadcast @ 1 Hz.
// Every fleet MCU (OVGT/OSSM/OCT, all Teensy 4.x) transmits this with its own
// source address; a listener collects records keyed by SA.
// Contract spec: ovgt docs/superpowers/specs/2026-07-06-mcu-health-j1939-pgn-design.md
/* Scope: J1939McuHealth */
const uint16_t J1939McuHealth_PGN = 0xFFDCU;
const uint16_t J1939McuHealth_TRANSMIT_INTERVAL_MS = 1000U;
const uint8_t J1939McuHealth_RESET_UNKNOWN = 0U;
const uint8_t J1939McuHealth_RESET_POR = 1U;
const uint8_t J1939McuHealth_RESET_LOCKUP = 2U;
const uint8_t J1939McuHealth_RESET_PIN = 3U;
const uint8_t J1939McuHealth_RESET_WDOG = 4U;
const uint8_t J1939McuHealth_RESET_WDOG3 = 5U;
const uint8_t J1939McuHealth_RESET_TEMPSENSE = 6U;
const uint8_t J1939McuHealth_RESET_JTAG = 7U;
const uint8_t J1939McuHealth_RESET_CSU = 8U;
const uint8_t J1939McuHealth_RESET_NOT_IMPLEMENTED = 0xFFU;

void J1939McuHealth_encode(const McuHealth* health, uint8_t out[8]) {
    if (health->temperatureValid == true) {
        uint16_t tempRaw = (uint16_t)((health->temperatureC + 273.0) * 32.0);
        out[0] = (uint8_t)((tempRaw) & 0xFFU);
        out[1] = (uint8_t)((tempRaw >> 8U) & 0xFFU);
    } else {
        out[0] = 0xFFU;
        out[1] = 0xFFU;
    }
    out[2] = health->resetCause;
    if (health->bootCountValid == true) {
        out[3] = ((health->bootCount) & 0xFFU);
        out[4] = ((health->bootCount >> 8U) & 0xFFU);
    } else {
        out[3] = 0xFFU;
        out[4] = 0xFFU;
    }
    if (health->uptimeValid == true) {
        out[5] = ((health->uptimeMinutes) & 0xFFU);
        out[6] = ((health->uptimeMinutes >> 8U) & 0xFFU);
    } else {
        out[5] = 0xFFU;
        out[6] = 0xFFU;
    }
    out[7] = 0xFFU;
}
